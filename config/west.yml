## config/west.yml
```yaml
manifest:
  remotes:
    - name: zmkfirmware
      url-base: https://github.com/zmkfirmware
    - name: cvcore
      url-base: https://github.com/cvcore
  projects:
    - name: zmk
      remote: cvcore
      revision: adv360-z3.2
      import: app/west.yml
  self:
    path: config
```
